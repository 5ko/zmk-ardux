## config/west.yml
```yaml
manifest:
  remotes:
    - name: zmkfirmware
      url-base: https://github.com/zmkfirmware
    #- name: zmk-ardux
      #url-base: https://github.com/arduxio
    - name: urob
      url-base: https://github.com/urob
  projects:
    - name: zmk
      remote: zmkfirmware
      #revision: 8c6bda260ace119b3c22a21bdcdd6d17a83fc5eb
      revision: bb486619a183f6df7fbb4620c80164555a22da0b
      import: app/west.yml
    - name: zmk-helpers
      remote: urob
      revision: main
  self:
    path: config
```
